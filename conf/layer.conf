## conf/layer.conf
```bitbake
LAYERSERIES_COMPAT_gfutures = "gatesgarth"
LAYERVERSION_gfutures = "1"

# We have a conf and classes directory, append to BBPATH
BBPATH .= ":${LAYERDIR}"

# We have a recipes directory containing .bb and .bbappend files, add to BBFILES
BBFILES += "${LAYERDIR}/recipes*/*/*.bb \
	    ${LAYERDIR}/recipes*/*/*/*.bb \
            ${LAYERDIR}/recipes*/*/*.bbappend"

BBFILE_PATTERN_gfutures := "^${LAYERDIR}/"
BBFILE_COLLECTIONS += "gfutures"
BBFILE_PRIORITY_tuxbox-core = "6"

# Additional license settings
LICENSE_PATH += "${LAYERDIR}/files/custom-licenses"
LICENSE_PATH += "${YOCTO_BASEDIR}/meta-neutrino/custom-licenses"
LICENSE_FLAGS_WHITELIST = "commercial"

# Prefered providers
PREFERRED_PROVIDER_virtual/neutrino = "neutrino-mp"
PREFFERED_PROVIDER_virtual/libstb-hal = "libstb-hal"
PREFFERED_PROVIDER_virtual/screengrabber = "grab"

# Image settings
IMAGEDIR = "${MACHINE}"
```

## conf/machine/bre2ze4k.conf
```bitbake
#@TYPE: Machine
#@NAME: WWIO BRE2ZE
#@DESCRIPTION: Machine configuration for the WWIO BRE2ZE Boxes
#@MAINTAINER: Markus Volk

require conf/machine/include/default-settings.inc
require conf/machine/include/bre2ze4k-h7-hd51-default-settings.inc
require conf/machine/include/bre2ze4k/tune-bre2ze4k.inc

MACHINE_DRIVER ?= "bre2ze4k"
MACHINE_BRAND = "WWIO"
MACHINE_NAME = "bre2ze4k"


MACHINE_ESSENTIAL_EXTRA_RDEPENDS += "gfutures-dvb-modules-bre2ze4k"

##preferred providers
PREFERRED_PROVIDER_virtual/kernel = "linux-gfutures"
PREFFERED_PROVIDER_virtual/dvb-driver = "gfutures-dvb-modules-bre2ze4k"
PREFERRED_PROVIDER_virtual/libgles1 = "hd-v3ddriver-bre2ze4k"
PREFERRED_PROVIDER_virtual/libgles2 = "hd-v3ddriver-bre2ze4k"
PREFERRED_PROVIDER_virtual/egl = "hd-v3ddriver-bre2ze4k"
```

## conf/machine/h7.conf
```bitbake
#@TYPE: Machine
#@NAME: Zgemma h7
#@DESCRIPTION: Machine configuration for the Zgemma h7 Boxes
#@MAINTAINER: Markus Volk

require conf/machine/include/default-settings.inc
require conf/machine/include/bre2ze4k-h7-hd51-default-settings.inc
require conf/machine/include/h7/tune-h7.inc

MACHINE_DRIVER ?= "h7"
MACHINE_BRAND = "ZGEMMA"
MACHINE_NAME = "h7"


MACHINE_ESSENTIAL_EXTRA_RDEPENDS += "zgemma-dvb-modules-h7"

##preferred providers
PREFERRED_PROVIDER_virtual/kernel = "linux-zgemma"
PREFFERED_PROVIDER_virtual/dvb-driver = "zgemma-dvb-modules-h7"
PREFERRED_PROVIDER_virtual/libgles1 = "zgemma-v3ddriver-h7"
PREFERRED_PROVIDER_virtual/libgles2 = "zgemma-v3ddriver-h7"
PREFERRED_PROVIDER_virtual/egl = "zgemma-v3ddriver-h7"
```

## conf/machine/hd51.conf
```bitbake
#@TYPE: Machine
#@NAME: AX HD51
#@DESCRIPTION: Machine configuration for the AX HD51 Boxes
#@MAINTAINER: Markus Volk

require conf/machine/include/default-settings.inc
require conf/machine/include/bre2ze4k-h7-hd51-default-settings.inc
require conf/machine/include/hd51/tune-hd51.inc

MACHINE_DRIVER ?= "hd51"
MACHINE_BRAND = "AX"
MACHINE_NAME = "hd51"


MACHINE_ESSENTIAL_EXTRA_RDEPENDS += "gfutures-dvb-modules-hd51"

##preferred providers
PREFERRED_PROVIDER_virtual/kernel = "linux-gfutures"
PREFFERED_PROVIDER_virtual/dvb-driver = "gfutures-dvb-modules-hd51"
PREFERRED_PROVIDER_virtual/libgles1 = "hd-v3ddriver-hd51"
PREFERRED_PROVIDER_virtual/libgles2 = "hd-v3ddriver-hd51"
PREFERRED_PROVIDER_virtual/egl = "hd-v3ddriver-hd51"
```

## conf/machine/include/bre2ze4k-h7-hd51-default-settings.inc
```bitbake
# hd51 bre2ze4k h7 BSP default settings

SOC_FAMILY = "bcm7251s"

MACHINE_FEATURES = "apm usbhost keyboard vfat ext2 wifi"

##preferred versions
PREFERRED_VERSION_linux-libc-headers = "4.10"
PREFERRED_VERSION_nativesdk-linux-libc-headers = "4.10"

MTD_ROOTFS = "mmcblk0p3"
MTD_KERNEL = "mmcblk0p2"
KERNEL_FILE = "kernel.bin"
ROOTFS_FILE = "rootfs.tar.bz2"

#IMAGE_CLASSES += "hd-emmc_image_single"
#IMAGE_CLASSES += "hd-emmc_image_multi"
IMAGE_CLASSES += "hd-emmc_image_multiboot"

IMAGE_FSTYPES += "hd-emmc"
```

## conf/machine/include/default-settings.inc
```bitbake
# default settings

MACHINE_KERNEL_PR = "r0"

MACHINE_EXTRA_RRECOMMENDS += " \
	kernel-modules \
"
```
